## firmware/sdkconfig.defaults
```kconfig
# Minimal project defaults. We'll add options here as features are introduced
# (e.g. Wi-Fi, custom partitions) in later roadmap phases.

CONFIG_IDF_TARGET="esp32"

# 1 kHz tick gives 1 ms scheduling resolution (handy once we add control loops).
CONFIG_FREERTOS_HZ=1000

# Enable WebSocket support in the HTTP server (interactive terminal).
CONFIG_HTTPD_WS_SUPPORT=y

# --- OTA (wireless firmware upload) ---
# Tell the build the board has a 4 MB flash chip...
CONFIG_ESPTOOLPY_FLASHSIZE_4MB=y
CONFIG_ESPTOOLPY_FLASHSIZE="4MB"
# ...and use our two-slot OTA partition table instead of the 1 MB default.
CONFIG_PARTITION_TABLE_CUSTOM=y
CONFIG_PARTITION_TABLE_CUSTOM_FILENAME="partitions.csv"
CONFIG_ESP_PHY_CALIBRATION_AND_DATA_STORAGE=n
```

## quick-checks/esp-now-mobile/sdkconfig.defaults
```kconfig
# Target the ESP32 DevKit so `idf.py build` works without a manual set-target.
CONFIG_IDF_TARGET="esp32"

# DevKit has a 4 MB flash chip; match it to silence the bootloader size warning.
CONFIG_ESPTOOLPY_FLASHSIZE_4MB=y
CONFIG_ESPTOOLPY_FLASHSIZE="4MB"

# Mobile keeps its console on the built-in USB, so normal logs are fine here.
```

## quick-checks/esp-now-uart-station/sdkconfig.defaults
```kconfig
# Target the ESP32 DevKit so `idf.py build` works without a manual set-target.
CONFIG_IDF_TARGET="esp32"

# DevKit has a 4 MB flash chip; match it so the bootloader stops warning that the
# detected size is larger than the image header.
CONFIG_ESPTOOLPY_FLASHSIZE_4MB=y
CONFIG_ESPTOOLPY_FLASHSIZE="4MB"

# WebSocket support in the HTTP server (the PC-facing side of the bridge).
CONFIG_HTTPD_WS_SUPPORT=y
```
